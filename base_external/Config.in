## base_external/Config.in
```kconfig
config BR2_PACKAGE_AESD_ASSIGNMENTS
    bool "AESD assignments"
    help
      Custom package for CU Boulder ECEN AELD assignments.
      Includes writer, finder, and test scripts.
```
